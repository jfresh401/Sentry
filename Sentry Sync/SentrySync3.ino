#include <ArduinoOTA.h>
#include <Wire.h>
#include <WiFi.h>
#include <WebServer.h>
#include <WiFiClient.h> //agregado
#include <Adafruit_GFX.h>
#include <Adafruit_SSD1306.h>
#include <SD.h>

//----------------------------------------------------------------------------------
//Built in Network settings
String Built_SSID = "Sentry";             //Any name you want
String Built_Password = "12345678";       //Any password you want
IPAddress Built_IP(192, 168, 4, 10);
IPAddress Built_Mask(255, 255, 255, 0);
//----------------------------------------------------------------------------------

#define SCREEN_WIDTH 128 // OLED display width, in pixels
#define SCREEN_HEIGHT 64 // OLED display height, in pixels
#define OLED_RESET -1    // Reset pin # (or -1 if sharing Arduino reset pin)
#define UART_BAUD_RATE 115200

Adafruit_SSD1306 display(SCREEN_WIDTH, SCREEN_HEIGHT, &Wire, OLED_RESET);


const char* ssid = "Smiths";
const char* password = "capitol401";

WebServer server(80);

String consoleData = "";
bool autoScroll = true;

const int MAX_LINES_WEB = 200; // Maximum number of lines to save for web
const int MAX_LINES_SCREEN = 8; // Maximum number of lines to display on the screen
String lines_screen[MAX_LINES_SCREEN]; // Array to store lines of text
String lines_web[MAX_LINES_WEB];
int lineCountScreen = 0; // Counter to keep track of the number of lines displayed
int lineCountWeb = 0;
bool receivedLines = false;

int scrollSpeed = 0; // Speed of text scrolling, 0 being instant

bool uartMode = false; // Variable to track the current mode

// Variables to store sensor data
float gpuTemp = 0.0;
float cpuTemp = 0.0;
float memTemp = 0.0;
float caseTemp = 0.0;

unsigned long previousMillis = 0;
const long interval = 2000; // Interval to update OLED display (milliseconds)

// 'sentrysplash', 128x64px
const unsigned char epd_bitmap_sentrysplash [] PROGMEM = {
  0x00, 0x00, 0x00, 0x00, 0x00, 0x00, 0x00, 0x00, 0x00, 0x00, 0x00, 0x00, 0x00, 0x00, 0x00, 0x00, 
  0x00, 0x00, 0x00, 0x00, 0x00, 0x00, 0x00, 0x00, 0x00, 0x00, 0x00, 0x00, 0x00, 0x00, 0x00, 0x00, 
  0x00, 0x00, 0x00, 0x00, 0x00, 0x00, 0x00, 0x00, 0x00, 0x00, 0x00, 0x00, 0x00, 0x00, 0x00, 0x00, 
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  0x00, 0x00, 0x00, 0x00, 0x00, 0x00, 0x00, 0x00, 0x00, 0x00, 0x00, 0x00, 0x00, 0x00, 0x00, 0x00
};

// 'question', 128x64px
const unsigned char epd_bitmap_question [] PROGMEM = {
  0x00, 0x00, 0x00, 0x00, 0x00, 0x00, 0x00, 0x00, 0x00, 0x00, 0x00, 0x00, 0x00, 0x00, 0x00, 0x00, 
  0x00, 0x00, 0x00, 0x00, 0x00, 0x00, 0x00, 0x00, 0x00, 0x00, 0x00, 0x00, 0x00, 0x00, 0x00, 0x00, 
  0x00, 0x00, 0x00, 0x00, 0x00, 0x00, 0x00, 0x00, 0x00, 0x00, 0x00, 0x00, 0x00, 0x00, 0x00, 0x00, 
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  0x00, 0x00, 0x00, 0x00, 0x00, 0x00, 0x00, 0x00, 0x00, 0x00, 0x00, 0x00, 0x00, 0x00, 0x00, 0x00
};

//----------------------------------------------------------------------------------
//WiFi connection
boolean ConectWiFi(void){
  boolean state = true;
  byte c = 0;
  WiFi.begin(ssid, password);
  while (WiFi.status() != WL_CONNECTED) {
    Serial.print(".");
    delay(500);
    if (c > 20){
      state = false;
      break;}
    c++;}
  return state;}

//----------------------------------------------------------------------------------
void setup() {
  Serial.begin(UART_BAUD_RATE);
  display.begin(SSD1306_SWITCHCAPVCC, 0x3C); // Initialize with the I2C addr 0x3C (for the 128x64)
  display.clearDisplay();

  WiFi.mode(WIFI_AP_STA);
  WiFi.softAPConfig(Built_IP, Built_IP, Built_Mask);   //IP, Gateway, Mask built in
  WiFi.softAP(Built_SSID, Built_Password);             //Net, Password built in
  delay(500); //delay to establish built in wifi
  
  //Connect to Wi-Fi
  Serial.println();
  Serial.print("Connecting to ");
  Serial.println(ssid);
  if(ConectWiFi()==true){
    Serial.println("");
    Serial.println("WiFi connected.");
    Serial.print("IP address: ");
    Serial.println(WiFi.localIP());}
  else{
    Serial.println("");
    Serial.println("WiFi not connected.");}
    
  //Start the web server
  server.on("/", HTTP_GET, handleRoot);
  server.on("/serialdata", HTTP_GET, handleSerialData);
  server.on("/autoscroll", HTTP_GET, handleAutoScroll);
  server.on("/clear", HTTP_GET, handleClear);
  server.begin();
  Serial.println("HTTP server started");

  // Display splash screen
  display.drawBitmap(0, 0, epd_bitmap_sentrysplash, 128, 64, SSD1306_WHITE);
  display.setTextSize(1);
  display.setTextColor(SSD1306_WHITE);
  display.setCursor(0, 55);
  display.println("  SentrySync Started");
  display.display(); // Display buffer
  delay(8000); // Display splash screen for 5 seconds

  // Clear the display
  display.clearDisplay();

  // Continue with the rest of the setup
  display.setTextSize(1); // Set text size
  display.setTextColor(SSD1306_WHITE); // Set text color
  display.setCursor(0, 0); // Set cursor position
  
  // Initialize SD card
  if (!SD.begin()) {
    Serial.println("SD Mount Failed");
    display.println("  SD Card Not Found!");
    display.display(); // Display buffer
    display.drawBitmap(0, 0, epd_bitmap_question, 128, 64, SSD1306_WHITE); // SD Card Image
    display.display(); // Display buffer
    delay(5000); // Wait for 5 seconds
    display.clearDisplay(); // Clear the display
  }
  ArduinoOTA.begin();
  Serial.println("OTA started");
}

//----------------------------------------------------------------------------------
void addLineUart(String line) {
  // Skip adding lines containing temp data so we aren't spamming the screen
  if (line.indexOf("eDRAM:") != -1 || line.indexOf("GPU:") != -1 || line.indexOf("CPU:") != -1 || line.indexOf("Mobo:") != -1) {
    return;
  }
  // If the screen is full, shift all lines up by one and add the new line at the bottom
  if (lineCountScreen >= MAX_LINES_SCREEN) {
    for (int i = 1; i < MAX_LINES_SCREEN; i++) {
      lines_screen[i - 1] = lines_screen[i];
    }
    lineCountScreen = MAX_LINES_SCREEN - 1;
  }

  // Trim line if it's too long
  if (line.length() > SCREEN_WIDTH) {
    line = line.substring(0, SCREEN_WIDTH);
  }

  // Add the new line at the bottom
  lines_screen[lineCountScreen++] = line;
  
  // Clear the display
  display.clearDisplay();
  display.setTextSize(1);
  display.setTextColor(SSD1306_WHITE);
  display.setCursor(0, 0);

  // Print all lines to the display
  for (int i = 0; i < lineCountScreen; i++) {
    display.println(lines_screen[i]);
  }

  display.display();

  // Adjust delay for scrolling speed
  delay(1000 / (26 - scrollSpeed)); // The higher the scrollSpeed, the slower the scrolling
}

//----------------------------------------------------------------------------------
void addLineWeb(String line) { 
  // Skip adding lines containing temp data so we aren't spamming the screen
  // if (line.indexOf("eDRAM:") != -1 || line.indexOf("GPU:") != -1 || line.indexOf("CPU:") != -1 || line.indexOf("Mobo:") != -1) {
  //   return;
  // }
  
  // If the web buffer is full, remove the oldest entry
  if (lineCountWeb >= MAX_LINES_WEB) {
    for (int i = 1; i < MAX_LINES_WEB; i++) {
      lines_web[i - 1] = lines_web[i];
    }
    lineCountWeb = MAX_LINES_WEB - 1;
  }

  // Add the new line at the bottom
  lines_web[lineCountWeb++] = line;

  receivedLines = true;
}

//----------------------------------------------------------------------------------
void loop() {
  ArduinoOTA.handle();
  
  server.handleClient();
  delay(10);//allow the cpu to switch to other tasks

  unsigned long currentMillis = millis();
  if (currentMillis - previousMillis >= interval && !uartMode) {
    // Time to update OLED display if not in UART mode
    previousMillis = currentMillis;
    updateOLED(); // Update OLED with temperature readings
  }

  if (Serial.available() > 0) {
    // Read the incoming byte from UART
    String data = Serial.readStringUntil('\n');
    if (data.startsWith("[Sentry] UART Mode")) {
      uartMode = true; // Switch to UART mode
    } else if (data.startsWith("[Sentry] Default Mode")) {
      uartMode = false; // Switch to Default mode
      display.clearDisplay();
      display.setTextSize(1); // Set text size
      display.setTextColor(SSD1306_WHITE); // Set text color
      display.setCursor(0, 0); // Set cursor position
    } else if (!uartMode) { // Process data only in Default mode
      processDefaultModeData(data);
      server.handleClient(); // Handle client requests
    }

    addLineWeb(data);

    // If in UART mode, add the received data line to the OLED display
    if (uartMode) {
      addLineUart(data);
    }

    // Print the incoming data to the serial monitor
    Serial.println(data);
  }
}

//----------------------------------------------------------------------------------
void updateOLED() {
  // Display sensor data on OLED
  display.setTextSize(2);
  display.clearDisplay();
  display.setCursor(0, 0);
  display.print("GPU: ");
  display.print(gpuTemp, 1); // Display GPU temperature with 1 decimal place
  display.print("C");
  display.println();
  display.print("CPU: ");
  display.print(cpuTemp, 1); // Display CPU temperature with 1 decimal place
  display.print("C");
  display.println();
  display.print("EDR: ");
  display.print(memTemp, 1); // Display MEM temperature with 1 decimal place
  display.print("C");
  display.println();
  display.print(" MB: ");
  display.print(caseTemp, 1); // Display Case temperature with 1 decimal place
  display.print("C");
  display.println();
  display.display();
}

//----------------------------------------------------------------------------------
void processDefaultModeData(String data) {
  if (data.startsWith("[Sentry] GPU:")) {
    gpuTemp = data.substring(13).toFloat();
  } else if (data.startsWith("[Sentry] CPU:")) {
    cpuTemp = data.substring(13).toFloat();
  } else if (data.startsWith("[Sentry] eDRAM:")) {
    memTemp = data.substring(15).toFloat();
  } else if (data.startsWith("[Sentry] Mobo:")) {
    caseTemp = data.substring(14).toFloat();
  } else if (data.startsWith("[Sentry] TitleID:")) {
    // Parse the title ID
    String titleID = data.substring(17);
    titleID.trim(); // Trim leading and trailing spaces
    if (titleID != "00000000") { // No idea why that get's reported but we ignore it
      // Display information from SD card
      displayInfoFromSD(titleID);
    }
  } else if (data.startsWith("[Sentry] IP:")) { // Check if the data contains IP address
    // Extract the IP address
    int ipStartIndex = data.indexOf(":") + 2; // Start index of the IP address
    String ipAddress = data.substring(ipStartIndex);

    // Check if the console has assigned an IP
    if (ipAddress != "0.0.0.0") {
      // Display IP address on OLED screen
      display.clearDisplay();
      display.setTextSize(1);
      display.setTextColor(SSD1306_WHITE);
      display.setCursor(0, 23);
      display.println("IP Address Acquired:");
      display.println(ipAddress);
      display.display(); // Display buffer

      delay(5000); // Display for 5 seconds
      updateOLED(); // Switch back to displaying temperature readings
    }
  }
}

//----------------------------------------------------------------------------------
void handleRoot() {
    String page = "<!DOCTYPE html>";
    page += "<html>";
    page += "<head>";
    page += "<title>Sentry Sync Webserver</title>";
    page += "<style> ";
    page += "body { ";
    page += "background-color: #212121; "; // Set background color
    page += "color: #B4B4B4; "; // Set text color
    page += "} ";
    page += "#console { ";
    page += "border: 1px solid black; ";
    page += "padding: 10px; ";
    page += "overflow-y: scroll; ";
    page += "height: 150px; ";
    page += "width: 35%; ";
    page += "} ";
    page += "#controls { ";
    page += "margin-top: 10px; ";
    page += "} ";
    page += "#controls label, #controls button { ";
    page += "display: inline-block; ";
    page += "margin-right: 10px; ";
    page += "} ";
    page += "</style>";
    page += "</head>";
    page += "<body>";
    page += "<h1>Sentry Sync Server For Xbox 360</h1>";
    page += "<h2>UART Output:</h2>";
    page += "<div id=\"console\">";
    page += "</div>";
    page += "<div id=\"controls\">";
    page += "<label><input type=\"checkbox\" id=\"autoscrollCheckbox\" onchange=\"toggleAutoScroll()\" checked> Autoscroll</label>";
    page += "<button onclick=\"clearConsole()\">Clear Output</button>";
    page += "</div>";
    page += "<script>";
    page += "var consoleDiv = document.getElementById('console');";
    page += "var autoScrollCheckbox = document.getElementById('autoscrollCheckbox');";
    page += "function updateConsole() {";
    page += "var xhr = new XMLHttpRequest();";
    page += "xhr.onreadystatechange = function() {";
    page += "if (xhr.readyState == 4 && xhr.status == 200) {";
    page += "var newData = xhr.responseText;";
    page += "if(newData !== 'No data available') {"; // Check if new data is available
    page += "consoleDiv.innerHTML += newData + '<br>';"; // Append new data with line break
    page += "if (autoScrollCheckbox.checked) {";
    page += "consoleDiv.scrollTop = consoleDiv.scrollHeight;"; // Scroll to bottom
    page += "}";
    page += "}";
    page += "}";
    page += "};";
    page += "xhr.open('GET', '/serialdata', true);";
    page += "xhr.send();";
    page += "}";
    page += "updateConsole();"; // Initially update console
    page += "setInterval(updateConsole, 100);"; // Update console every 100 milliseconds
    page += "function toggleAutoScroll() {";
    page += "autoScroll = autoScrollCheckbox.checked;";
    page += "}";
    page += "function clearConsole() {";
    page += "consoleDiv.innerHTML = '';"; // Clear console content
    page += "}";
    page += "</script>";
    page += "</body>";
    page += "</html>";

    server.send(200, "text/html", page); // Send response to the client
}

//----------------------------------------------------------------------------------
void handleSerialData() {
    String message = "";
    if(receivedLines){
      for (int i = 0; i < lineCountWeb; i++) {
        message += lines_web[i] + '\n';
        lines_web[i] = "";
      }
      lineCountWeb = 0;
      receivedLines = false;
    }
    server.send(200, "text/plain", message); // Send response to the client
}

//----------------------------------------------------------------------------------
void handleAutoScroll() {
    autoScroll = !autoScroll;
    server.send(200, "text/plain", String(autoScroll));
}

//----------------------------------------------------------------------------------
void handleClear() {
    consoleData = ""; // Clear console data
    server.send(200, "text/plain", "Console cleared");
}

//----------------------------------------------------------------------------------
void displayInfoFromSD(String targetTitleID) {
  targetTitleID.trim(); // Trim leading and trailing spaces

  // Get the elapsed time since the program started
  unsigned long elapsedSeconds = millis() / 1000;

  // Check if the elapsed time is less than 25 seconds and the target title ID is fffe07d1 (Dashboard)
  if (elapsedSeconds < 25 && targetTitleID.equalsIgnoreCase("fffe07d1")) {
    // Do nothing and return without processing
    return;
  }

  // Attempt to open the file
  File file = SD.open("/gamelist.txt");
  if (!file) {
    Serial.println("Failed to open file for reading");
    return;
  }

  // Convert targetTitleID to lowercase
  targetTitleID.toLowerCase();

  // Read each line of the file
  while (file.available()) {
    String line = file.readStringUntil('\n');
    line.trim(); // Trim leading and trailing spaces

    // Extract the title ID from the line
    int asteriskIndex = line.indexOf('*');
    if (asteriskIndex == -1) {
      // Invalid line format, skip to the next line
      continue;
    }
    String titleID = line.substring(0, asteriskIndex);
    
    // Check if the extracted title ID matches the target title ID in lowercase
    if (titleID.equalsIgnoreCase(targetTitleID)) {
      // Parse information from the line
      String gameInfo = line.substring(asteriskIndex + 1);
      int asterisk1 = gameInfo.indexOf('*');
      int asterisk2 = gameInfo.indexOf('*', asterisk1 + 1);
      String gameTitle = gameInfo.substring(0, asterisk1);
      String developer = gameInfo.substring(asterisk1 + 1, asterisk2);

      // Display information on OLED screen
      display.clearDisplay();
      display.setTextSize(1);
      display.setTextColor(SSD1306_WHITE);
      display.setCursor(0, 0);
      display.println(gameTitle);
      display.println();
      display.print("Title ID: ");
      targetTitleID.toUpperCase(); // Converts title id to uppercase
      display.println(targetTitleID); // Displays title id in uppercase
      display.println();
      display.println("Developer:");
      display.println(developer);
      display.display(); // Display buffer

      delay(10000); // Display for 10 seconds
      updateOLED(); // Switch back to displaying temperature readings

      file.close();
      return; // Stop searching after finding the first match
    }
  }

  // Close the file
  file.close();

  Serial.println("Title ID not found");
}
