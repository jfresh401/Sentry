#include <ArduinoOTA.h>
#include <Wire.h>
#include <WiFi.h>
#include <WebServer.h>
#include <WiFiClient.h> 
#include <Adafruit_GFX.h>
#include <Adafruit_SSD1306.h> 
#include <SD.h>
#include <SPI.h>
#include <esp_now.h>


//----------------------------------------------------------------------------------
//   Using ESP32 WROOM Dev board
//----------------------------------------------------------------------------------
#define SCREEN_WIDTH 128 // OLED display width, in pixels
#define SCREEN_HEIGHT 64 // OLED display height, in pixels
#define OLED_RESET -1    // Reset pin # (or -1 if sharing Arduino reset pin)
#define UART_BAUD_RATE 115200

Adafruit_SSD1306 display(SCREEN_WIDTH, SCREEN_HEIGHT, &Wire, OLED_RESET);

const char* ssid = "NETWORK NAME";
const char* password = "PASSWORD";

bool uartMode = false; // Variable to track the uart mode
bool sdStatus = false; // Variable to track if sd card is present
bool tidStatus = false; // Variable to track if title id was sent via uart
// Variables to store sensor data
float gpuTemp = 0.0;
float cpuTemp = 0.0;
float memTemp = 0.0;
float caseTemp = 0.0;
String gameTitle;
String titleID;
String developer;
String ipAddress;
String lastID = "";

unsigned long previousMillis = 0;
const long interval = 2000; // Interval to update OLED display (milliseconds)


// 'sentrysplash', 128x64px
const unsigned char epd_bitmap_sentrysplash [] PROGMEM = {
  0x00, 0x00, 0x00, 0x00, 0x00, 0x00, 0x00, 0x00, 0x00, 0x00, 0x00, 0x00, 0x00, 0x00, 0x00, 0x00, 
  0x00, 0x00, 0x00, 0x00, 0x00, 0x00, 0x00, 0x00, 0x00, 0x00, 0x00, 0x00, 0x00, 0x00, 0x00, 0x00, 
  0x00, 0x00, 0x00, 0x00, 0x00, 0x00, 0x00, 0x00, 0x00, 0x00, 0x00, 0x00, 0x00, 0x00, 0x00, 0x00, 
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  0x00, 0x00, 0x00, 0x00, 0x00, 0x00, 0x00, 0x00, 0x00, 0x00, 0x00, 0x00, 0x00, 0x00, 0x00, 0x00
};

// 'question', 128x64px
const unsigned char epd_bitmap_question [] PROGMEM = {
  0x00, 0x00, 0x00, 0x00, 0x00, 0x00, 0x00, 0x00, 0x00, 0x00, 0x00, 0x00, 0x00, 0x00, 0x00, 0x00, 
  0x00, 0x00, 0x00, 0x00, 0x00, 0x00, 0x00, 0x00, 0x00, 0x00, 0x00, 0x00, 0x00, 0x00, 0x00, 0x00, 
  0x00, 0x00, 0x00, 0x00, 0x00, 0x00, 0x00, 0x00, 0x00, 0x00, 0x00, 0x00, 0x00, 0x00, 0x00, 0x00, 
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  0x00, 0x00, 0x00, 0x00, 0x00, 0x00, 0x00, 0x00, 0x00, 0x00, 0x00, 0x00, 0x00, 0x00, 0x00, 0x00
};

//----------------------------------------------------------------------------------
//WiFi connection
boolean ConectWiFi(void){
  boolean state = true;
  byte c = 0;
  WiFi.begin(ssid, password);
  while (WiFi.status() != WL_CONNECTED) {
    Serial.print(".");
    delay(500);
    if (c > 20){
      state = false;
      break;}
    c++;}
  return state;}

// Structure to receive data
// Must match the sender structure
typedef struct struct_message {
  float gTemp;
  float cTemp;
  float eTemp;
  float mTemp;
  bool sd;
  bool uart;
  bool tidSent;
  char gameTitle[32];
  char developer[32];
  char tTitleID[32];
  char xboxipAdd[32];
} struct_message;

// struct_message called myData
struct_message myData;

// callback function that will be executed when data is received
void OnDataRecv(const uint8_t * mac, const uint8_t *incomingData, int len) {
  memcpy(&myData, incomingData, sizeof(myData));
  gpuTemp = myData.gTemp;
  cpuTemp = myData.cTemp;
  memTemp = myData.eTemp;
  caseTemp = myData.mTemp;
  sdStatus = myData.sd;
  uartMode = myData.uart;
  tidStatus = myData.tidSent;
  gameTitle = myData.gameTitle;
  developer = myData.developer;
  titleID = myData.tTitleID;
  ipAddress = myData.xboxipAdd;

  Serial.print("Bytes received: ");
  Serial.println(len);
  Serial.print("GPU: ");
  Serial.println(myData.gTemp);
  Serial.print("CPU: ");
  Serial.println(myData.cTemp);
  Serial.print("EDRAM: ");
  Serial.println(myData.eTemp);
  Serial.print("MOBO: ");
  Serial.println(myData.mTemp);
  Serial.print("SD Status: ");
  Serial.println(myData.sd);
  Serial.print("UART Mode: ");
  Serial.println(myData.uart);
  Serial.print("TiD Sent: ");
  Serial.println(myData.tidSent);
  Serial.print("Game Title: ");
  Serial.println(myData.gameTitle);
  Serial.print("Developer: ");
  Serial.println(myData.developer);
  Serial.print("Title ID: ");
  Serial.println(myData.tTitleID);
  Serial.print("IP Address: ");
  Serial.println(myData.xboxipAdd);
  Serial.println();
    
  if (myData.tidSent) { 
    tidStatus = true;         
  }
  if (!tidStatus){
    lastID = "";
  }
}

//----------------------------------------------------------------------------------
void setup() {
  Serial.begin(UART_BAUD_RATE);
  display.begin(SSD1306_SWITCHCAPVCC, 0x3C); // Initialize with the I2C addr 0x3C (for the 128x64)
  delay(300);
  display.clearDisplay();

  WiFi.mode(WIFI_STA);
  delay(300);
  
  //Connect to Wi-Fi
  Serial.println();
  Serial.print("Connecting to ");
  Serial.println(ssid);
  if(ConectWiFi()==true){
    Serial.println("");
    Serial.println("WiFi connected.");
    Serial.print("IP address: ");
    Serial.println(WiFi.localIP());}
  else{
    Serial.println("");
    Serial.println("WiFi not connected.");}
    
  // Init ESP-NOW
  if (esp_now_init() != ESP_OK) {
    Serial.println("Error initializing ESP-NOW");
    
  }
  else {
    Serial.println("initialized ESP-NOW!!");
  }
  
  // Once ESPNow is successfully Init, register for recv CB to
  // get recv packer info
  esp_now_register_recv_cb(esp_now_recv_cb_t(OnDataRecv));

  // Display splash screen
  display.drawBitmap(0, 0, epd_bitmap_sentrysplash, 128, 64, SSD1306_WHITE);
  display.setTextSize(1);
  display.setTextColor(SSD1306_WHITE);
  display.setCursor(0, 55);
  display.println("  SentrySync Started");
  display.display(); // Display buffer
  delay(5000); // Display splash screen for 5 seconds

  // Clear the display
  display.clearDisplay();
 
  // Initialize SD card
  if (!sdStatus) {
    Serial.println("SD Mount Failed");
    display.println("  SD Card Not Found!");
    display.display(); // Display buffer
    display.drawBitmap(0, 0, epd_bitmap_question, 128, 64, SSD1306_WHITE); // SD Card Image
    display.display(); // Display buffer
    delay(5000); // Wait for 5 seconds
    display.clearDisplay(); // Clear the display   
  }
  
  
  ArduinoOTA.begin();
  Serial.println("OTA started");

  if (ipAddress != "0.0.0.0") {
          
    // Display IP address on OLED screen
    display.clearDisplay();
    display.setTextSize(1);
    display.setTextColor(SSD1306_WHITE);
    display.setCursor(0, 23);
    display.println("IP Address Acquired:");
    display.println(ipAddress);
    display.display(); // Display buffer
    delay(5000); // Display for 5 seconds
    updateOLED();
  }
  else{
    delay(5000);
    updateOLED();
  }
}


//----------------------------------------------------------------------------------
void loop() {
  ArduinoOTA.handle();
  delay(100);//allow the cpu to switch to other tasks
  
  if (millis() - previousMillis >= interval) {
    previousMillis = millis();
    updateOLED();
  }  
}

//----------------------------------------------------------------------------------
void updateOLED() {
  if (tidStatus && titleID != lastID) {
    displayInfoFromSD(titleID);
    lastID = titleID; // Update the last displayed title ID
    tidStatus = false;
  }
  

    // Display sensor data on OLED
  display.setTextSize(2);
  display.setTextColor(SSD1306_WHITE);
  display.clearDisplay();
  display.setCursor(0, 0);
  display.print("GPU: ");
  display.print(gpuTemp, 1); // Display GPU temperature with 1 decimal place
  display.print("C");
  display.println();
  display.print("CPU: ");
  display.print(cpuTemp, 1); // Display CPU temperature with 1 decimal place
  display.print("C");
  display.println();
  display.print("EDR: ");
  display.print(memTemp, 1); // Display MEM temperature with 1 decimal place
  display.print("C");
  display.println();
  display.print(" MB: ");
  display.print(caseTemp, 1); // Display Case temperature with 1 decimal place
  display.print("C");
  display.println();
  display.display();
   
}

//----------------------------------------------------------------------------------
void displayInfoFromSD(String targetTitleID) {

  // Display information on OLED screen
  display.clearDisplay();
  display.setTextSize(1);
  display.setTextColor(SSD1306_WHITE);
  display.setCursor(0, 0);
  display.println(gameTitle);
  display.println();
  display.print("Title ID: ");
  targetTitleID.toUpperCase(); // Converts title id to uppercase
  display.println(targetTitleID); // Displays title id in uppercase
  display.println();
  display.println("Developer:");
  display.println(developer);
  display.display(); // Display buffer    
  delay(8000); // Display for 10 seconds
  display.clearDisplay();
}
